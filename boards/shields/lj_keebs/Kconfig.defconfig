## boards/shields/lj_keebs/Kconfig.defconfig
```kconfig
# Copyright (c) 2023 The ZMK Contributors
# SPDX-License-Identifier: MIT

if SHIELD_LJ_KEEBS_LEFT

config ZMK_KEYBOARD_NAME
    default "LJ KEEBS"

config ZMK_SPLIT_ROLE_CENTRAL
    default y

endif # SHIELD_LJ_KEEBS_LEFT

if SHIELD_LJ_KEEBS_LEFT || SHIELD_LJ_KEEBS_RIGHT

config ZMK_SPLIT
    default y

config ZMK_RGB_UNDERGLOW
    select WS2812_STRIP
    select SPI

if ZMK_DISPLAY

config SSD1306
    default y

config I2C
    default y

config SSD1306_REVERSE_MODE
    default y

endif # ZMK_DISPLAY

if LVGL

config LV_Z_VDB_SIZE
    default 64

config LV_DPI_DEF
    default 148

config LV_Z_BITS_PER_PIXEL
    default 1

choice LV_COLOR_DEPTH
    default LV_COLOR_DEPTH_1
endchoice

endif # LVGL

endif # SHIELD_LJ_KEEBS_LEFT || SHIELD_LJ_KEEBS_RIGHT
```
